## config/west.yml
```yaml
manifest:
  remotes:
    - name: zmkfirmware
      url-base: https://github.com/zmkfirmware
    - name: carrefinho
      url-base: https://github.com/carrefinho
    - name: urob
      url-base: https://github.com/urob
  projects:
    - name: zmk
      remote: urob
      revision: main
      import: app/west.yml
    - name: prospector-zmk-module
      remote: carrefinho
      revision: main
    - name: zmk-helpers
      remote: urob
      revision: main
      path: modules/helpers
  self:
    path: config
```
